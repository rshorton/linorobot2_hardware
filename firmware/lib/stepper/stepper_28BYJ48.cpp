// This code was mostly generated by Google Gemini with various tweaks.

#include "Arduino.h"

#include "stepper_28BYJ48.h"
#include "logger.h"

#define FULL_STEPS

namespace
{

#ifdef FULL_STEPS
    // Full-stepping sequence
    const byte step_sequence[4] = {
        0b00011, 0b00110, 0b01100, 0b01001
    };
    const int STEP_MASK = 0x3;
    const long STEPS_PER_REV = 2048;
#else
    // Smooth half-stepping sequence
    const byte step_sequence[8] = {
        0b00001, 0b00011, 0b00010, 0b00110,
        0b00100, 0b01100, 0b01000, 0b01001
    };
    const int STEP_MASK = 0x7;
    const long STEPS_PER_REV = 4096;
#endif
//    const long UPDATE_RATE_WHEN_IDLE_US = 500000;
    const long UPDATE_RATE_WHEN_IDLE_US = 50000;

    // Only one instance of Stepper28BYJ48 can be used since a Teensy 4 IntervalTimer
    // is used to control stepper output timing
    IntervalTimer step_timer;
    Stepper28BYJ48 *interval_timer_obj = nullptr;
}

void step_motor_isr()
{
    if (interval_timer_obj) {
        interval_timer_obj->update();
    }
}    

Stepper28BYJ48::Stepper28BYJ48(int pin1, int pin2, int pin3, int pin4,
                               float max_steps_per_sec, float acceleration) :
    stepper_pins_{pin1, pin2, pin3, pin4},
    max_speed_(max_steps_per_sec),
    acceleration_(acceleration)
{
    for (int i = 0; i < 4; i++) {
        pinMode(stepper_pins_[i], OUTPUT);
    }
}

Stepper28BYJ48::~Stepper28BYJ48()
{
    step_timer.end();
    interval_timer_obj = nullptr;
}

long Stepper28BYJ48::get_steps_per_rev() const {
    return STEPS_PER_REV;
}

bool Stepper28BYJ48::move_to_position(long position)
{
    target_pos_ = position;
    osc_mode_pos_ = 0;

    if (!inited_) {
        if (interval_timer_obj != nullptr) {
            Logger::log_message(Logger::LogLevel::Error, "Stepper28BYJ48, failed to init, timer already in use.");  
            return false;
        }
        interval_timer_obj = this;
        run_ = true;
        // Start hardware timer tracking
        step_timer.begin(step_motor_isr, cur_interval_);
        inited_ = true;
        Logger::log_message(Logger::LogLevel::Info, "Stepper28BYJ48, initialized");  
    }
    return true;
}

void Stepper28BYJ48::set_osc_mode(long position)
{
    osc_mode_pos_ = position;
}

long Stepper28BYJ48::get_position() const
{
    return cur_pos_;
}

long Stepper28BYJ48::get_target_position() const
{
    return target_pos_;
}

bool Stepper28BYJ48::at_position() const
{
    return target_pos_ == cur_pos_;
}

void Stepper28BYJ48::set_current_pos(long position)
{
    run_ = false;
    cur_pos_ = position;
    target_pos_ = position;
    run_ = true;
}
void Stepper28BYJ48::stop()
{
    run_ = false;
}

void Stepper28BYJ48::finished()
{
    cur_speed_ = 0.0;

    // Shut off all coils to prevent the motor from overheating while stationary
    digitalWriteFast(stepper_pins_[0], LOW);
    digitalWriteFast(stepper_pins_[1], LOW);
    digitalWriteFast(stepper_pins_[2], LOW);
    digitalWriteFast(stepper_pins_[3], LOW);

    // Slow update rate when idle
    step_timer.update(UPDATE_RATE_WHEN_IDLE_US);
}

// Called in an ISR
void Stepper28BYJ48::update()
{
    // Check if we have arrived at the destination
    long distance_to_go = target_pos_ - cur_pos_;
    
    if (!run_ || (distance_to_go == 0 && osc_mode_pos_ == 0)) {
        finished();
        return; 
    }

    // If oscillation mode enabled and done with current phase,
    // move in opposite dir
    if (distance_to_go == 0 && osc_mode_pos_ != 0) {
        target_pos_ = osc_mode_pos_ * (target_pos_ > 0? -1: 1);
    }

    // Determine direction of rotation
    int direction = (distance_to_go > 0) ? 1 : -1;

    // Calculate steps required to stop completely from current speed
    // Equation: d = v^2 / (2 * a)
    float stopping_distance_ = (cur_speed_ * cur_speed_) / (2.0 * acceleration_);

    // Time step elapsed
    float dt = cur_interval_ / 1000000.0;

    // Trapezoidal Speed Calculation (Ramp Up, Cruise, or Ramp Down)
    if (abs(distance_to_go) <= stopping_distance_) {
        // Decelerate: We are nearing the target
        cur_speed_ -= acceleration_ * dt;
        if (cur_speed_ < min_speed_) cur_speed_ = min_speed_;
    } else {
        // Accelerate or Cruise
        cur_speed_ += acceleration_ * dt;
        if (cur_speed_ > max_speed_) cur_speed_ = max_speed_;
    }

    // Update step sequencing based on direction
    if (direction > 0) {
        cur_seq_index_ = (cur_seq_index_ + 1) & STEP_MASK;
        cur_pos_++;
    } else {
        cur_seq_index_ = (cur_seq_index_ - 1) & STEP_MASK;
        cur_pos_--;
    }

    // Output bitmask to the ULN2003 pins
    byte cur_mask_ = step_sequence[cur_seq_index_];
    digitalWriteFast(stepper_pins_[0], cur_mask_ & 0b00001);
    digitalWriteFast(stepper_pins_[1], cur_mask_ & 0b00010);
    digitalWriteFast(stepper_pins_[2], cur_mask_ & 0b00100);
    digitalWriteFast(stepper_pins_[3], cur_mask_ & 0b01000);

    // Dynamically update the hardware clock interval
    cur_interval_ = 1000000.0 / cur_speed_;
    step_timer.update(cur_interval_);
}

